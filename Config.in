## Config.in
```kconfig
source "$BR2_EXTERNAL_THINGYJP_PATH/package/thingymcconfig/Config.in"
source "$BR2_EXTERNAL_THINGYJP_PATH/package/thingymcconfig-exampleapp/Config.in"
source "$BR2_EXTERNAL_THINGYJP_PATH/package/thingyjp-ota/Config.in"
source "$BR2_EXTERNAL_THINGYJP_PATH/package/thingyjp-dnsd/Config.in"
source "$BR2_EXTERNAL_THINGYJP_PATH/package/libnlglue/Config.in"
source "$BR2_EXTERNAL_THINGYJP_PATH/package/libteenynet/Config.in"
```

## package/libnlglue/Config.in
```kconfig
config BR2_PACKAGE_LIBNLGLUE
	bool "libnlglue"
	select BR2_PACKAGE_LIBGLIB2
	select BR2_PACKAGE_LIBNL
	help
```

## package/libteenynet/Config.in
```kconfig
config BR2_PACKAGE_LIBTEENYNET
	bool "libteenynet"
	select BR2_PACKAGE_LIBGLIB2
	help
```

## package/thingyjp-connector-mqtt/Config.in
```kconfig
config BR2_PACKAGE_THINGYJP_CONNECTOR_MQTT
	bool "connector for MQTT"
	depends on BR2_PACKAGE_THINGYMCCONFIG
	depends on BR2_PACKAGE_MOSQUITTO
```

## package/thingyjp-dnsd/Config.in
```kconfig
config BR2_PACKAGE_THINGYJP_DNSD
	bool "thingyjp-dnsd"
	select BR2_PACKAGE_GLIB
	select BR2_PACKAGE_C_ARES
```

## package/thingyjp-ota/Config.in
```kconfig
config BR2_PACKAGE_THINGYJP_OTA
	bool "thingyjp-ota"
	select BR2_PACKAGE_THINGYMCCONFIG
	select BR2_PACKAGE_JSON_GLIB
	help
	  OTA for Linux based things

config BR2_PACKAGE_THINGYJP_OTA_REPODIR
	string "repo directory"
	depends on BR2_PACKAGE_THINGYJP_OTA
	help
	  Location of directory that contains your repo

config BR2_PACKAGE_THINGYJP_OTA_KEYSDIR
	string "keys directory"
	depends on BR2_PACKAGE_THINGYJP_OTA
	help
	  Location of directory that contains your public key

config BR2_PACKAGE_THINGYJP_OTA_STAMP
	bool "stamp image"
	depends on BR2_PACKAGE_THINGYJP_OTA
	help
	  Use the stamp tool to add the uuid and version number into the image
```

## package/thingymcconfig-exampleapp/Config.in
```kconfig
config BR2_PACKAGE_THINGYMCCONFIG_EXAMPLE
	bool "example app"
	depends on BR2_PACKAGE_THINGYMCCONFIG
	help
	  Example application for thingymcconfig
```

## package/thingymcconfig/Config.in
```kconfig
config BR2_PACKAGE_THINGYMCCONFIG
	bool "thingymcconfig"
	select BR2_PACKAGE_LIBMICROHTTPD
	select BR2_PACKAGE_LIBMICROHTTPD_SSL
	select BR2_PACKAGE_JSON_GLIB
	select BR2_PACKAGE_WPA_SUPPLICANT
	select BR2_PACKAGE_WPA_SUPPLICANT_AP_SUPPORT
	select BR2_PACKAGE_LIBNLGLUE
	select BR2_PACKAGE_LIBTEENYNET
	select BR2_PACKAGE_LIBGPIOD
	depends on BR2_PACKAGE_IFUPDOWN_SCRIPTS=n
	help
	  Provisioning and configuration for Linux based things

config BR2_PACKAGE_THINGYMCCONFIG_INTERFACE
	string "interface"
	depends on BR2_PACKAGE_THINGYMCCONFIG
	default "wlan0"
	help
	  Name of the interface that thingymcconfig should manage
```
